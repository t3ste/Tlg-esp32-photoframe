## components/board_hal/Kconfig
```kconfig
menu "Board Configuration"

    choice BOARD_TYPE
        prompt "Power Management Driver"
        default BOARD_DRIVER_WAVESHARE_PHOTOPAINTER
        help
            Select the power management driver to use.

        config BOARD_DRIVER_WAVESHARE_PHOTOPAINTER
            bool "WaveShare PhotoPainter"
            help
                Driver for WaveShare PhotoPainter (Spectra 6) board.
                Includes AXP2101 PMIC initialization and SHTC3 sensor sleep management.

        config BOARD_DRIVER_XIAO_EE02
            bool "Seeed XIAO EE02 (BQ24070)"
            help
                Driver for Seeed Studio XIAO EE02 board.
                Uses BQ24070 Linear Charger.
                Voltage is read via ADC. Percentage is estimated.
                Charging status via GPIO.

    endchoice

endmenu
```

## components/epaper_driver_ed2208_gca/Kconfig
```kconfig
config EP_DRIVER_ED2208_GCA
    bool "E-Ink ED2208-GCA (Spectra 6 800x480)"
    help
        Driver for 7.3 inch Spectra 6 E-Paper displays (Waveshare PhotoPainter, Seeed reTerminal E1002).
```

## components/epaper_driver_spectra_e6/Kconfig
```kconfig
config EP_DRIVER_SPECTRA_E6
    bool "Spectra E6 (7.3 Inch: Waveshare/reTerminal)"
    help
        Driver for 7.3 inch Spectra 6 E-Paper displays (Waveshare, Seeed reTerminal E1002).
        This board typically includes an AXP2101 PMIC and/or SD Card slot.
```

## components/epaper_driver_t133a01/Kconfig
```kconfig
config EP_DRIVER_SEEEDSTUDIO_T133A01
    bool "Seeed XIAO EE02 (13.3 Inch)"
    help
        Driver for Seeed Studio XIAO EE02 board with 13.3 inch Spectra 6 display.
        This board does NOT have an AXP PMIC or SD Card slot.
```

## components/rtc_driver_pcf8563/Kconfig
```kconfig
config RTC_DRIVER_PCF8563
    bool "PCF8563 RTC"
    help
        Enable support for PCF8563 real-time clock.
```

## sdkconfig.defaults.seeedstudio_reterminal_e1002
```kconfig
# Seeed Studio reTerminal E1002 Specifics
CONFIG_BOARD_DRIVER_SEEEDSTUDIO_RETERMINAL_E1002=y

# Flash Configuration
CONFIG_ESPTOOLPY_FLASHSIZE_32MB=y
CONFIG_ESPTOOLPY_FLASHSIZE="32MB"
```

## sdkconfig.defaults.seeedstudio_xiao_ee02
```kconfig
# Seeed XIAO EE02 Specifics
CONFIG_EP_DRIVER_SPECTRA_E6=y
CONFIG_BOARD_DRIVER_SEEEDSTUDIO_XIAO_EE02=y
```

## sdkconfig.defaults.xiao_ee02
```kconfig
CONFIG_EP_DRIVER_XIAO_EE02=y
CONFIG_BOARD_DRIVER_XIAO_EE02=y
CONFIG_HAS_SDCARD=n
```
